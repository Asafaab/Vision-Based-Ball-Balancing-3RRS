/dts-v1/;
/plugin/;

/ {
    compatible = "brcm,bcm2712";
    fragment@0 {
        target = <&rp1_gpio>;
        __overlay__ {
            balancer_pwm_pins: balancer_pwm_pins {
                pins = "gpio12", "gpio13", "gpio18";
                function = "pwm0";
                bias-disable;
            };
        };
    };
    fragment@1 {
        target = <&rp1_pwm0>;
        __overlay__ {
            status = "okay";
            pinctrl-names = "default";
            pinctrl-0 = <&balancer_pwm_pins>;
        };
    };
};
